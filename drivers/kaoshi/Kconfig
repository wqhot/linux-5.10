## drivers/kaoshi/Kconfig
```kconfig
# SPDX-License-Identifier: GPL-2.0-only
#
# KAOSHI device configuration
#

menuconfig KAOSHI
	bool "KAOSHI drivers"
    depends on PREEMPT_RT
	help
	  KAOSHI.

	  Select this option if you want your kernel to support KAOSHI.

if KAOSHI

source "drivers/kaoshi/stackhack/Kconfig"

endif # KAOSHI
```

## drivers/kaoshi/stackhack/Kconfig
```kconfig
# SPDX-License-Identifier: GPL-2.0-only
config KAOSHI_STACKHACK
	def_bool KAOSHI
	help
	  KAOSHI STACKHACK
```

## kaoshi/Kconfig
```kconfig
# SPDX-License-Identifier: GPL-2.0-only
#
# KAOSHI device configuration
#

menuconfig KAOSHI
	tristate "KAOSHI drivers"
    depends on PREEMPT_RT
	help
	  KAOSHI.

	  Select this option if you want your kernel to support KAOSHI.

if KAOSHI

source "kaoshi/stackhack/Kconfig"

endif # KAOSHI
```

## kaoshi/stackhack/Kconfig
```kconfig
# SPDX-License-Identifier: GPL-2.0-only
config KAOSHI_STACKHACK
	tristate "kaoshi stackhack"
	help
	  kaoshi stackhack

config STACK_HACK_PROTECT
	bool "Protect against stack hacking"
	help
	  This option help to protect against stack hacking.
```
